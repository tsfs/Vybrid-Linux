## arch/arm/mach-mvf/Kconfig
```kconfig
if ARCH_MVF

config	ARCH_VF6XX
	bool
	#select USB_ARCH_HAS_EHCI
	select ARCH_MXC_IOMUX_VMVF
	#select ARCH_MXC_AUDMUX_V2
	select ARM_GIC
	#select ARCH_HAS_CPUFREQ
	#select IMX_HAVE_PLATFORM_IMX_UART
	select IMX_HAVE_PLATFORM_FEC
	#select IMX_HAVE_PLATFORM_IMX_ANATOP_THERMAL
	#select IMX_HAVE_PLATFORM_IMX_IPUV3
	#select IMX_HAVE_PLATFORM_MXC_PWM
	#select IMX_HAVE_PLATFORM_LDB
	#select IMX_HAVE_PLATFORM_IMX_SPDIF

config	SOC_VF6XX
	bool

config MACH_TWR_VF600
	bool "Support MVF TWR-VF600 platform"
	select ARCH_VF6XX
	select SOC_VF6XX
	#select IMX_HAVE_PLATFORM_IMX_UART
	#select IMX_HAVE_PLATFORM_DMA
	select IMX_HAVE_PLATFORM_FEC
	#select IMX_HAVE_PLATFORM_GPMI_NFC
	#select IMX_HAVE_PLATFORM_SDHCI_ESDHC_IMX
	#select IMX_HAVE_PLATFORM_SPI_IMX
	#select IMX_HAVE_PLATFORM_IMX_I2C
	#select IMX_HAVE_PLATFORM_VIV_GPU
	#select IMX_HAVE_PLATFORM_IMX_VPU
	#select IMX_HAVE_PLATFORM_IMX_DVFS
	#select IMX_HAVE_PLATFORM_IMX_ESAI
	#select IMX_HAVE_PLATFORM_IMX_SSI
	#select IMX_HAVE_PLATFORM_IMX_ANATOP_THERMAL
	#select IMX_HAVE_PLATFORM_FSL_USB2_UDC
	#select IMX_HAVE_PLATFORM_MXC_EHCI
	#select IMX_HAVE_PLATFORM_FSL_OTG
	#select IMX_HAVE_PLATFORM_FSL_USB_WAKEUP
	#select IMX_HAVE_PLATFORM_AHCI
	#select IMX_HAVE_PLATFORM_IMX_OCOTP
	#select IMX_HAVE_PLATFORM_IMX_VIIM
	#select IMX_HAVE_PLATFORM_IMX2_WDT
	#select IMX_HAVE_PLATFORM_IMX_SNVS_RTC
	#select IMX_HAVE_PLATFORM_IMX_PM
	#select IMX_HAVE_PLATFORM_MXC_HDMI
	#select IMX_HAVE_PLATFORM_IMX_ASRC
	#select IMX_HAVE_PLATFORM_IMX_SPDIF
	#select IMX_HAVE_PLATFORM_IMX_MIPI_DSI
	#select IMX_HAVE_PLATFORM_FLEXCAN
	#select IMX_HAVE_PLATFORM_IMX_MIPI_CSI2
	#select IMX_HAVE_PLATFORM_PERFMON
	#select IMX_HAVE_PLATFORM_MXC_MLB
	#select IMX_HAVE_PLATFORM_IMX_EPDC
	#select IMX_HAVE_PLATFORM_IMX_PXP
	help
	  Include support for i.MX Faraday platform. This includes specific
	  configurations for the board and its peripherals.

comment "MVF Options:"

menu "IOMUX Setting"

choice
	prompt "TWR-VF600 IOMUX Setting"
	default IOMUX_PRIMARY
	depends on MACH_TWR_VF600

config IOMUX_PRIMARY
	bool "Primary"
	help
	  Setup IOMUX as Primary Function

config IOMUX_SECONDARY
	bool "Secondary"
	help
	  Setup IOMUX as Secondary Function

endchoice

endmenu

config IMX_PCIE
	bool "PCI Express support"
	select PCI

endif
```

## drivers/media/video/mvf/Kconfig
```kconfig
config VIDEO_MVF_DCU_OUTPUT
	bool "DCU v4l2 support"
	depends on VIDEO_MVF_OUTPUT && MVF_DCU
	default y
	---help---
	  This is the video4linux2 driver for DCU video output.
```

## drivers/mvf/Kconfig
```kconfig
#drivers/video/mvf/Kconfig

if ARCH_MVF

menu "MVF support drivers"

config MVF_DCU
	bool "Display Controller Unit Driver"
	depends on ARCH_VF6XX
	select MVF_DCU_V4 if ARCH_VF6XX
	help
	  If you plan to use the Display Controller unit, say
	  Y here. DCU is needed by Framebuffer and V4L2 drivers.

source "drivers/mvf/dcu4/Kconfig"

endmenu

endif
```

## drivers/video/mvf/Kconfig
```kconfig
config FB_MVF
	tristate "MVF Framebuffer support"
	depends on FB && (MVF_DCU || ARCH_VF6XX)
	default y
	help
	  This is a framebuffer device for the MVF LCD Controller.
	  See <http://www.linux-fbdev.org/> for information on framebuffer
	  devices.

	  If you plan to use the LCD display with your MVF system, say
	  Y here.

config FB_MVF_NUM_FBS
	int "Number of Framebuffers"
	range 1 32
	default 1
	depends on FB_MVF
	help
	  Select the number of framebuffers corresponding to layers
	  desired.  
```
